## boards/shields/lgk246/Kconfig.defconfig
```kconfig
if SHIELD_LGK246_LEFT

config LGK246
    default "LGK246"

config ZMK_SPLIT_ROLE_CENTRAL
    default y

endif

if SHIELD_LGK246_LEFT || SHIELD_LGK246_RIGHT

config ZMK_SPLIT
    default y

endif
```

## config/boards/shields/lgk246/Kconfig.defconfig
```kconfig
# Copyright (c) 2022 The ZMK Contributors
# SPDX-License-Identifier: MIT

if SHIELD_LGK246_LEFT

config ZMK_KEYBOARD_NAME
    default "LGK246"
    
config ZMK_SPLIT_ROLE_CENTRAL
    default y

endif

if SHIELD_LGK246_LEFT || SHIELD_LGK246_RIGHT

config ZMK_SPLIT
    default y

endif
```

## config/boards/shields/totem/Kconfig.shield
```kconfig
# Copyright (c) 2022 The ZMK Contributors
# SPDX-License-Identifier: MIT

config SHIELD_LGK246_LEFT
    def_bool $(shields_list_contains,lgk246_left)

config SHIELD_LGK246_RIGHT
    def_bool $(shields_list_contains,lgk246_right)
```
